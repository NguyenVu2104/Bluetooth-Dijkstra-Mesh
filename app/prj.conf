## Kconfig
```
mainmenu "Bluetooth Dijkstra Mesh"

config APP_NODE_ID
	int "Node ID for this build (0=A, 1=B, 2=C)"
	default 0
	help
	  Identifies this node in the static routing graph.

config APP_FAULT_INJECTION
	bool "Bật fault injection trên Node B (demo M4)"
	default n
	help
	  Khi bật, node có APP_NODE_ID=1 (Node B) sẽ chủ động "làm rớt" mọi
	  gói DATA mà nó nhận trực tiếp từ Node A (tức prev_hop_id của gói
	  bằng 0) — không ACK, không forward. Đây là fault injection ở tầng
	  application, dùng để mô phỏng hiện tượng mất gói một chiều trên
	  liên kết A-B, kích hoạt cơ chế tăng cost và Dijkstra reroute.
	  Cờ này chỉ có tác dụng khi build cho Node B — build cho Node A/C
	  bật cờ này cũng không làm gì cả vì điều kiện kiểm tra self_id.

source "Kconfig.zephyr"

# ==============================================================================
# BẢN CHẤT CỦA FILE KCONFIG:
# 1. Zephyr tự động tìm file có tên chính xác là "Kconfig" (không cần đuôi mở rộng).
# 2. Khi gõ 'west build', công cụ Kconfiglib sẽ đọc file này TRƯỚC TIÊN.
# 3. Kconfiglib tự động dịch các lệnh dưới đây thành file mã C ẩn (autoconf.h).
#    (Ví dụ: nó sinh ra dòng '#define CONFIG_APP_NODE_ID 0' trong autoconf.h)
# 4. Lợi ích: Cho phép đổi cấu hình từ terminal mà không cần sửa mã C.
# ==============================================================================
```

## prj.conf
```kconfig
# Để trống ở M0

#M1:
#CONFIG_APP_NODE_ID=0

#M2:
CONFIG_BT=y
CONFIG_BT_OBSERVER=y
CONFIG_BT_BROADCASTER=y

# main.c ban M3 dung snprintf()/strlen() de dung chuoi "Hello from X".
# Minimal libc mac dinh cua Zephyr da ho tro cac dinh dang %s/%c/%u
# (khong dinh dang so thuc nen chua can bat day du libc). Neu build
# bao loi "undefined reference to snprintf" hoac output UART bi rac,
# bo comment dong duoi de chuyen sang libc day du:
# CONFIG_NEWLIB_LIBC=y
```

## src/routing.c
```c
/**
 * @file routing.c
 * @brief Cài đặt Dijkstra generic O(N^2) — vòng lặp thuật toán không đổi
 *        gì so với M3. Điểm mới của M4 là graph có thêm 1 bản sao "cost
 *        gốc" để nhớ hồi phục về đâu, cùng 2 hàm chuyên biệt để tăng và
 *        hồi phục cost thay vì để main.c tự gán 1 con số tuỳ ý.
 */

#include "routing.h"
#include <stdbool.h>
#include <string.h>

/** Ma trận kề hiện tại — cái Dijkstra thực sự đọc mỗi lần được gọi. Cost
 *  có thể thay đổi theo thời gian từ M4 (miss làm tăng, success làm hồi
 *  phục). */
static uint8_t graph[ROUTING_NODE_COUNT][ROUTING_NODE_COUNT];

/** Ma trận kề "gốc" — chụp lại đúng lúc routing_init(), không bao giờ
 *  đổi sau đó. Cần lưu riêng vì một khi graph[] đã bị miss ghi đè nhiều
 *  lần (vd 1 -> 2 -> 4 -> 8), không có cách nào tự suy ngược lại được
 *  "giá trị ban đầu là bao nhiêu" nếu không có bản sao này. */
static uint8_t base_graph[ROUTING_NODE_COUNT][ROUTING_NODE_COUNT];

void routing_set_cost(uint8_t node_a, uint8_t node_b, uint8_t cost)
{
    /* Graph vô hướng — cost phải đối xứng cả 2 chiều */
    graph[node_a][node_b] = cost;
    graph[node_b][node_a] = cost;
}

/** Ghi cost gốc cho 1 cạnh vào base_graph — chỉ dùng nội bộ lúc
 *  routing_init(). Không cần expose ra ngoài vì main.c không bao giờ
 *  cần biết "cost gốc là bao nhiêu", chỉ cần gọi record_miss/
 *  record_success và để routing.c tự lo phần còn lại. */
static void set_base_cost(uint8_t node_a, uint8_t node_b, uint8_t cost)
{
    base_graph[node_a][node_b] = cost;
    base_graph[node_b][node_a] = cost;
}

void routing_init(void)
{
    for (int i = 0; i < ROUTING_NODE_COUNT; i++) {
        for (int j = 0; j < ROUTING_NODE_COUNT; j++) {
            graph[i][j] = (i == j) ? 0 : ROUTING_COST_INF;
            base_graph[i][j] = graph[i][j];
        }
    }

    /* Topology M4: A=0, B=1, C=2. So với M3, thêm cạnh A-C cost=5 để khi
     * A-B xuống cấp, Dijkstra có 1 đường thay thế thật sự thay vì chỉ
     * mất route hoàn toàn — đây chính là điều kiện để chứng minh
     * "rerouting" thay vì chỉ "phát hiện mất route". */
    routing_set_cost(0, 1, 1);
    set_base_cost(0, 1, 1);

    routing_set_cost(1, 2, 1);
    set_base_cost(1, 2, 1);

    routing_set_cost(0, 2, 5);
    set_base_cost(0, 2, 5);
}

void routing_record_miss(uint8_t node_a, uint8_t node_b)
{
    /* Dùng uint16_t để nhân tạm thời, tránh tràn số uint8_t trước khi
     * kịp so sánh với trần ROUTING_COST_INF. */
    uint16_t doubled = (uint16_t)graph[node_a][node_b] * 2;

    if (doubled >= ROUTING_COST_INF) {
        doubled = ROUTING_COST_INF;
    }
    routing_set_cost(node_a, node_b, (uint8_t)doubled);
}

void routing_record_success(uint8_t node_a, uint8_t node_b)
{
    /* Hồi phục thẳng về cost gốc — không giảm dần từng bước, đủ đơn
     * giản để minh hoạ ý tưởng "link tốt trở lại" trong phạm vi M4. */
    routing_set_cost(node_a, node_b, base_graph[node_a][node_b]);
}

uint8_t routing_get_cost(uint8_t node_a, uint8_t node_b)
{
    return graph[node_a][node_b];
}

uint8_t routing_next_hop(uint8_t self_id, uint8_t dst_id)
{
    uint8_t dist[ROUTING_NODE_COUNT];
    uint8_t prev[ROUTING_NODE_COUNT];
    bool visited[ROUTING_NODE_COUNT];

    for (int i = 0; i < ROUTING_NODE_COUNT; i++) {
        dist[i] = ROUTING_COST_INF;
        prev[i] = ROUTING_INVALID_NODE;
        visited[i] = false;
    }
    dist[self_id] = 0;

    /* Vòng lặp Dijkstra chuẩn — không đổi gì so với M3. Nó luôn đọc
     * graph[] mới nhất tại thời điểm được gọi, nên tự động "thấy" mọi
     * thay đổi cost do routing_record_miss()/routing_record_success()
     * gây ra mà không cần biết gì về sự tồn tại của 2 hàm đó. */
    for (int iter = 0; iter < ROUTING_NODE_COUNT; iter++) {
        uint8_t u = ROUTING_INVALID_NODE;
        uint8_t best = ROUTING_COST_INF;

        for (int i = 0; i < ROUTING_NODE_COUNT; i++) {
            if (!visited[i] && dist[i] < best) {
                best = dist[i];
                u = i;
            }
        }
        if (u == ROUTING_INVALID_NODE) {
            break; /* Phần graph còn lại không tới được từ self_id */
        }
        visited[u] = true;

        for (int v = 0; v < ROUTING_NODE_COUNT; v++) {
            if (graph[u][v] == ROUTING_COST_INF) {
                continue;
            }
            uint16_t alt = (uint16_t)dist[u] + graph[u][v];
            if (alt < dist[v]) {
                dist[v] = (uint8_t)alt;
                prev[v] = u;
            }
        }
    }

    if (dst_id == self_id || dist[dst_id] == ROUTING_COST_INF) {
        return ROUTING_INVALID_NODE;
    }

    uint8_t path[ROUTING_NODE_COUNT];
    int path_len = 0;
    uint8_t cur = dst_id;

    while (cur != self_id) {
        path[path_len++] = cur;
        cur = prev[cur];
    }

    return path[path_len - 1];
}
```

## src/routing.h
```c
/**
 * @file routing.h
 * @brief API tính toán đường đi ngắn nhất (Dijkstra) trên một static graph
 *        cục bộ. Mỗi node giữ 1 bản copy graph riêng, khởi tạo giống nhau,
 *        và tự chạy Dijkstra độc lập — đây là mô hình hop-by-hop routing,
 *        không phải source routing.
 *
 *        Từ M4: graph không còn "tĩnh tuyệt đối" như M3 nữa — cost của
 *        từng cạnh có thể tăng lên khi phát hiện mất gói
 *        (routing_record_miss) và hồi phục lại khi gửi thành công
 *        (routing_record_success). Bản thân thuật toán Dijkstra trong
 *        routing_next_hop() không cần đổi gì cả, vì nó luôn đọc cost
 *        hiện tại của graph tại thời điểm được gọi — đây chính là lý do
 *        M3 đã cố tình viết Dijkstra tổng quát thay vì hardcode 3 node.
 */

#ifndef ROUTING_H_
#define ROUTING_H_

/* Cho phép build routing.c độc lập trên host (gcc thường, không cần
 * Zephyr) để unit test Dijkstra riêng. */
#ifdef ROUTING_HOST_TEST
#include <stdint.h>
#else
#include <zephyr/types.h>
#endif

#define ROUTING_NODE_COUNT   3
#define ROUTING_COST_INF     255   /**< "Không có cạnh" hoặc "cạnh đã coi như đứt hẳn" */
#define ROUTING_INVALID_NODE 0xFF  /**< Giá trị trả về khi không tìm được route */

/**
 * @brief Khởi tạo graph tĩnh ban đầu của M4: A(0)-B(1) cost=1, B(1)-C(2)
 *        cost=1, và A(0)-C(2) cost=5 — cạnh A-C là điểm mới so với M3,
 *        cho phép Dijkstra chọn đường thay thế thật sự khi A-B xuống
 *        cấp, thay vì chỉ mất route hoàn toàn. Cost gốc của mỗi cạnh
 *        cũng được lưu lại riêng, để routing_record_success() biết
 *        "hồi phục về giá trị nào".
 *        Phải gọi 1 lần duy nhất trong main() trước khi các thread bắt
 *        đầu gọi routing_next_hop().
 */
void routing_init(void);

/**
 * @brief Gán thẳng cost cho 1 cạnh (đối xứng cả 2 chiều). Đây là hàm mức
 *        thấp, dùng nội bộ bởi routing_init()/routing_record_miss()/
 *        routing_record_success(). Code ở main.c nên dùng 2 hàm chuyên
 *        biệt bên dưới thay vì gọi thẳng hàm này, để thể hiện đúng ý
 *        định (miss/success) thay vì tự gán 1 con số cost tuỳ ý.
 *
 * @param node_a Một đầu cạnh
 * @param node_b Đầu còn lại của cạnh
 * @param cost   Cost mới (dùng ROUTING_COST_INF để "xoá" cạnh)
 */
void routing_set_cost(uint8_t node_a, uint8_t node_b, uint8_t cost);

/**
 * @brief Ghi nhận 1 lần mất gói (hết số lần gửi cho phép mà vẫn không
 *        có ACK) trên cạnh (node_a, node_b) — nhân đôi cost hiện tại
 *        của cạnh này, chặn lại ở ROUTING_COST_INF nếu vượt quá. Gọi
 *        hàm này khi máy trạng thái gửi-có-đảm bảo ở main.c rơi vào
 *        trạng thái "mất gói".
 *
 * @param node_a Một đầu cạnh vừa bị miss
 * @param node_b Đầu còn lại
 */
void routing_record_miss(uint8_t node_a, uint8_t node_b);

/**
 * @brief Ghi nhận 1 lần gửi thành công (có ACK) trên cạnh (node_a,
 *        node_b) — đưa cost của cạnh này về đúng giá trị gốc lúc
 *        routing_init(), coi như link đã "khỏi hẳn" ngay khi có 1 lần
 *        thành công, không giảm dần từng bước. Gọi khi máy trạng thái ở
 *        main.c rơi vào trạng thái "thành công".
 *
 * @param node_a Một đầu cạnh vừa gửi thành công
 * @param node_b Đầu còn lại
 */
void routing_record_success(uint8_t node_a, uint8_t node_b);

/**
 * @brief Đọc cost hiện tại của 1 cạnh — chỉ dùng để in log cho dễ theo
 *        dõi khi demo (vd in ra cost hiện tại của A-B sau mỗi lần mất
 *        gói), không ảnh hưởng gì tới việc tính Dijkstra.
 *
 * @param node_a Một đầu cạnh
 * @param node_b Đầu còn lại
 * @return Cost hiện tại (ROUTING_COST_INF nếu không có cạnh)
 */
uint8_t routing_get_cost(uint8_t node_a, uint8_t node_b);

/**
 * @brief Chạy Dijkstra từ self_id trên graph nội bộ, trả về node id của
 *        trạm kế tiếp (next-hop) trên đường đi ngắn nhất tới dst_id.
 *
 * @param self_id Node đang gọi hàm này (gốc của Dijkstra)
 * @param dst_id  Đích cuối cùng cần tới
 * @return Node id của next-hop, hoặc ROUTING_INVALID_NODE nếu dst_id
 *         không tới được hoặc dst_id == self_id (gọi sai ngữ cảnh).
 */
uint8_t routing_next_hop(uint8_t self_id, uint8_t dst_id);

#endif /* ROUTING_H_ */
```

## src/transport.c
```c
/**
 * @file transport.c
 * @brief Cài đặt tầng vận chuyển bằng BLE Broadcaster + Observer role.
 *        KHÔNG ĐỔI GÌ về logic so với M3 — toàn bộ ACK/retry/state machine
 *        của M4 nằm ở main.c, transport.c vẫn chỉ có nhiệm vụ gửi/nhận
 *        byte thô qua BLE, đúng như đã chốt trong bảng Decision/Rationale
 *        (mục "File placement").
 */

#include <string.h>
#include <zephyr/kernel.h>
#include <zephyr/bluetooth/bluetooth.h>
#include <zephyr/bluetooth/gap.h>
#include "transport.h"
#include "packet.h"

#define ADV_INTERVAL_GUARD_MS 1300

/** M4: tăng số slot từ 8 (M3) lên 10 — RX thread giờ có thể bận tới
 *  ~9.6s cho 1 giao dịch ACK/retry, trong lúc đó các gói TX định kỳ
 *  (1s/lần) khác vẫn có thể tới và cần chỗ chứa tạm. CHÚ Ý: đây chỉ là
 *  giảm nguy cơ tràn hàng đợi trong phạm vi demo 3-node, không phải giải
 *  pháp triệt để — nếu RX thread bận đủ lâu, số gói đến trong lúc đó vẫn
 *  có thể vượt quá 10 slot. */
K_MSGQ_DEFINE(rx_msgq, APP_MSG_LEN, 10, 4);

static struct k_mutex send_lock;

static const struct bt_le_adv_param *adv_param = BT_LE_ADV_PARAM(
    BT_LE_ADV_OPT_NONE,
    BT_GAP_ADV_SLOW_INT_MIN, BT_GAP_ADV_SLOW_INT_MAX,
    NULL);

static const struct bt_le_scan_param scan_param = {
    .type     = BT_LE_SCAN_TYPE_PASSIVE,
    .options  = BT_LE_SCAN_OPT_NONE,
    .interval = BT_GAP_SCAN_FAST_INTERVAL,
    .window   = BT_GAP_SCAN_FAST_WINDOW,
};

static bool adv_started;

static bool data_cb(struct bt_data *data, void *user_data)
{
    ARG_UNUSED(user_data);

    if (data->type == BT_DATA_MANUFACTURER_DATA && data->data_len == APP_MSG_LEN) {
        const struct packet *pkt = (const struct packet *)data->data;

        if (pkt->src_id != (uint8_t)CONFIG_APP_NODE_ID) {
            k_msgq_put(&rx_msgq, data->data, K_NO_WAIT);
        }
    }
    return true;
}

static void scan_cb(const bt_addr_le_t *addr, int8_t rssi,
                     uint8_t adv_type, struct net_buf_simple *buf)
{
    ARG_UNUSED(addr);
    ARG_UNUSED(rssi);
    ARG_UNUSED(adv_type);

    bt_data_parse(buf, data_cb, NULL);
}

int transport_init(void)
{
    k_mutex_init(&send_lock);

    int err = bt_enable(NULL);
    if (err) {
        return err;
    }

    err = bt_le_scan_start(&scan_param, scan_cb);
    if (err) {
        return err;
    }

    adv_started = false;
    return 0;
}

int transport_send(const uint8_t *data, size_t len)
{
    struct bt_data ad[] = {
        BT_DATA(BT_DATA_MANUFACTURER_DATA, data, len),
    };
    int ret;

    k_mutex_lock(&send_lock, K_FOREVER);

    if (!adv_started) {
        ret = bt_le_adv_start(adv_param, ad, ARRAY_SIZE(ad), NULL, 0);
        if (ret == 0) {
            adv_started = true;
        }
    } else {
        ret = bt_le_adv_update_data(ad, ARRAY_SIZE(ad), NULL, 0);
    }

    if (ret == 0) {
        k_sleep(K_MSEC(ADV_INTERVAL_GUARD_MS));
    }

    k_mutex_unlock(&send_lock);
    return ret;
}

int transport_recv(uint8_t *buf, size_t buf_len, k_timeout_t timeout)
{
    if (buf_len < APP_MSG_LEN) {
        return -EINVAL;
    }
    return k_msgq_get(&rx_msgq, buf, timeout);
}
```
