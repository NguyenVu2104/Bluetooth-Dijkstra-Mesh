## CMakeLists.txt
```
cmake_minimum_required(VERSION 3.20.0)

find_package(Zephyr REQUIRED HINTS $ENV{ZEPHYR_BASE})
project(bluetooth_dijkstra)

#M2 thêm file mới
target_sources(app PRIVATE src/main.c src/transport.c)
```

## prj.conf
```kconfig
# Để trống ở M0 — Zephyr đã tự bật UART console/printk mặc định trên
# nrf52840dk qua defconfig của board. Sẽ thêm CONFIG khi có lý do cụ thể
# (ví dụ CONFIG_BT=y ở M2 khi bắt đầu cần BLE).

#M1:
#CONFIG_APP_NODE_ID=0

#M2:
CONFIG_BT=y
CONFIG_BT_OBSERVER=y
CONFIG_BT_BROADCASTER=y
```

## src/main.c
```c
#include <zephyr/kernel.h>
#include <zephyr/sys/printk.h>
#include <zephyr/sys/byteorder.h>
#include "transport.h"

#define TX_PERIOD_MS 1000
#define MAX_NODES    3

static void encode_msg(uint8_t *buf, uint8_t node_id, uint32_t counter)
{
    buf[0] = node_id;
    sys_put_le32(counter, &buf[1]);
}

static void decode_msg(const uint8_t *buf, uint8_t *node_id, uint32_t *counter)
{
    *node_id = buf[0];
    *counter = sys_get_le32(&buf[1]);
}

void tx_thread_entry(void *p1, void *p2, void *p3)
{
    ARG_UNUSED(p1); ARG_UNUSED(p2); ARG_UNUSED(p3);

    uint8_t msg[APP_MSG_LEN];
    uint32_t counter = 0;

    while (1) {
        counter++;
        encode_msg(msg, (uint8_t)CONFIG_APP_NODE_ID, counter);

        int ret = transport_send(msg, sizeof(msg));
        if (ret == 0) {
            printk("[TX] Da gui, counter = %u\n", counter);
        } else {
            printk("[TX] LOI gui, counter = %u (ret=%d)\n", counter, ret);
        }

        k_sleep(K_MSEC(TX_PERIOD_MS));
    }
}

void rx_thread_entry(void *p1, void *p2, void *p3)
{
    ARG_UNUSED(p1); ARG_UNUSED(p2); ARG_UNUSED(p3);

    uint8_t msg[APP_MSG_LEN];
    uint32_t last_seen[MAX_NODES] = {0};

    while (1) {
        int ret = transport_recv(msg, sizeof(msg), K_FOREVER);
        if (ret != 0) {
            continue;
        }

        uint8_t sender_id;
        uint32_t counter;
        decode_msg(msg, &sender_id, &counter);

        if (sender_id >= MAX_NODES) {
            continue; /* du lieu la, bo qua */
        }
        if (counter == last_seen[sender_id]) {
            continue; /* trung lap do BLE tu phat lai, khong phai gia tri moi */
        }
        last_seen[sender_id] = counter;

        printk("[RX] Nhan tu Node %u, counter = %u\n", sender_id, counter);
    }
}

/* Tao thread o trang thai suspended (SYS_FOREVER_MS) - danh thuc sau khi BLE san sang */
K_THREAD_DEFINE(tx_tid, 1024, tx_thread_entry, NULL, NULL, NULL, 7, 0, SYS_FOREVER_MS);
K_THREAD_DEFINE(rx_tid, 1024, rx_thread_entry, NULL, NULL, NULL, 7, 0, SYS_FOREVER_MS);

int main(void)
{
    printk("Node ID = %d\n", CONFIG_APP_NODE_ID);

    int err = transport_init();
    if (err) {
        printk("Loi khoi tao transport: %d\n", err);
        return 0;
    }

    k_thread_start(tx_tid);
    k_thread_start(rx_tid);

    return 0;
}
```

## src/transport.c
```c
// phần boilerplate BLE cố định:
// #include <zephyr/bluetooth/bluetooth.h>
// #include "transport.h"

// static const struct bt_le_adv_param adv_param = BT_LE_ADV_PARAM(
//     BT_LE_ADV_OPT_NONE,   /* không connectable — đúng vai trò Broadcaster */
//     BT_GAP_ADV_FAST_INT_MIN_2, BT_GAP_ADV_FAST_INT_MAX_2, NULL);

// static const struct bt_le_scan_param scan_param = {
//     .type     = BT_LE_SCAN_TYPE_PASSIVE,
//     .options  = BT_LE_SCAN_OPT_NONE,
//     .interval = BT_GAP_SCAN_FAST_INTERVAL,
//     .window   = BT_GAP_SCAN_FAST_WINDOW,
// };

// static void scan_cb(const bt_addr_le_t *addr, int8_t rssi,
//                      uint8_t adv_type, struct net_buf_simple *buf)
// {
//     // TODO (bạn viết): bt_data_parse(buf, ...) tìm AD type BT_DATA_MANUFACTURER_DATA,
//     // copy nội dung + rssi vào 1 struct, k_msgq_put() vào tx_to_rx_q.
//     // KHÔNG printk dài hay xử lý logic nặng ở đây.
// }

// int transport_init(void)
// {
//     int err = bt_enable(NULL);
//     if (err) {
//         return err;
//     }
//     return bt_le_scan_start(&scan_param, scan_cb);
// }

// int transport_send(const uint8_t *data, size_t len)
// {
//     struct bt_data ad[] = {
//         BT_DATA(BT_DATA_MANUFACTURER_DATA, data, len),
//     };
//     // TODO (bạn quyết định): gọi bt_le_adv_start() lần đầu trong transport_init(),
//     // các lần sau dùng bt_le_adv_update_data() thay vì stop()+start() lại —
//     // xem câu hỏi 4 bên dưới.
//     return bt_le_adv_start(&adv_param, ad, ARRAY_SIZE(ad), NULL, 0);
// }

#include <string.h>
#include <zephyr/kernel.h>
#include <zephyr/bluetooth/bluetooth.h>
#include <zephyr/bluetooth/gap.h>
#include "transport.h"

K_MSGQ_DEFINE(rx_msgq, APP_MSG_LEN, 8, 4);

/* SỬA: adv_param giờ là CON TRỎ, không phải struct */
static const struct bt_le_adv_param *adv_param = BT_LE_ADV_PARAM(
    BT_LE_ADV_OPT_NONE,
    BT_GAP_ADV_SLOW_INT_MIN, BT_GAP_ADV_SLOW_INT_MAX,
    NULL);

static const struct bt_le_scan_param scan_param = {
    .type     = BT_LE_SCAN_TYPE_PASSIVE,
    .options  = BT_LE_SCAN_OPT_NONE,
    .interval = BT_GAP_SCAN_FAST_INTERVAL,
    .window   = BT_GAP_SCAN_FAST_WINDOW,
};

static bool adv_started;

static bool data_cb(struct bt_data *data, void *user_data)
{
    ARG_UNUSED(user_data);

    if (data->type == BT_DATA_MANUFACTURER_DATA && data->data_len == APP_MSG_LEN) {
        /* Tu loc: bo qua neu byte dau (NODE_ID nguoi gui) trung voi chinh minh */
        if (data->data[0] != (uint8_t)CONFIG_APP_NODE_ID) {
            k_msgq_put(&rx_msgq, data->data, K_NO_WAIT);
        }
    }
    return true; /* tiep tuc quet cac AD structure khac neu co */
}

static void scan_cb(const bt_addr_le_t *addr, int8_t rssi,
                     uint8_t adv_type, struct net_buf_simple *buf)
{
    ARG_UNUSED(addr);
    ARG_UNUSED(rssi);
    ARG_UNUSED(adv_type);

    bt_data_parse(buf, data_cb, NULL);
}

int transport_init(void)
{
    int err = bt_enable(NULL);
    if (err) {
        return err;
    }

    err = bt_le_scan_start(&scan_param, scan_cb);
    if (err) {
        return err;
    }

    adv_started = false;
    return 0;
}

int transport_send(const uint8_t *data, size_t len)
{
    struct bt_data ad[] = {
        BT_DATA(BT_DATA_MANUFACTURER_DATA, data, len),
    };

    if (!adv_started) {
        int err = bt_le_adv_start(adv_param, ad, ARRAY_SIZE(ad), NULL, 0);  /* bỏ & */
        if (err == 0) {
            adv_started = true;
        }
        return err;
    }

    return bt_le_adv_update_data(ad, ARRAY_SIZE(ad), NULL, 0);
}

int transport_recv(uint8_t *buf, size_t buf_len, k_timeout_t timeout)
{
    if (buf_len < APP_MSG_LEN) {
        return -EINVAL;
    }
    return k_msgq_get(&rx_msgq, buf, timeout);
}
```

## src/transport.h
```c
#ifndef TRANSPORT_H_
#define TRANSPORT_H_

#include <zephyr/kernel.h>

/* Quy uoc payload M2: byte 0 = NODE_ID nguoi gui, byte 1-4 = counter (little-endian).
 * Se duoc thay the bang struct packet chinh thuc o M3. */
#define APP_MSG_LEN 5

int transport_init(void);
int transport_send(const uint8_t *data, size_t len);
int transport_recv(uint8_t *buf, size_t buf_len, k_timeout_t timeout);

#endif
```
